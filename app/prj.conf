## CMakeLists.txt
```
cmake_minimum_required(VERSION 3.20.0)

find_package(Zephyr REQUIRED HINTS $ENV{ZEPHYR_BASE})
project(beatbox)

target_sources(app PRIVATE
    src/main.c
    src/synth.c
    src/sequencer.c
    src/ui.c
)

if(CONFIG_ARCH_POSIX)
    target_sources(app PRIVATE src/audio_out.c)
else()
    target_sources(app PRIVATE src/audio_pcm.c)
endif()

target_include_directories(app PRIVATE src)
```

## prj.conf
```kconfig
# Console / shell so you can drive the sequencer interactively
CONFIG_CONSOLE=y
CONFIG_SHELL=y
CONFIG_SHELL_BACKEND_SERIAL=y
CONFIG_SHELL_PROMPT_UART="beatbox:~$ "

# Logging kept minimal so it doesn't interleave with the WAV sample dump
CONFIG_LOG=y
CONFIG_LOG_DEFAULT_LEVEL=2
CONFIG_LOG_MODE_MINIMAL=y

CONFIG_MAIN_STACK_SIZE=5120
CONFIG_SHELL_STACK_SIZE=4096

# Give the sequencer thread a bit more room since rendering is done inline
CONFIG_HEAP_MEM_POOL_SIZE=8192

CONFIG_DISPLAY=y
CONFIG_INPUT=y

CONFIG_LVGL=y
CONFIG_LV_Z_MEM_POOL_SIZE=98304
CONFIG_LV_Z_VDB_SIZE=64
CONFIG_LV_Z_FLUSH_THREAD=n

# Catch stack overlflow
CONFIG_HW_STACK_PROTECTION=y
CONFIG_STACK_SENTINEL=y
```

## boards/native_sim.overlay
```dts
/*
 * Copyright (c) 2026 Muhammad Waleed Badar
 *
 * SPDX-License-Identifier: Apache-2.0
 */

&uart1 {
	status = "okay";
	label = "UART_1";
};

&sdl_dc {
	height = <320>;
	width = <480>;
};
```

## src/main.c
```c
/*
 * Copyright (c) 2026 Muhammad Waleed Badar
 *
 * SPDX-License-Identifier: Apache-2.0
 */

#include <stdio.h>
#include <stdlib.h>
#include <string.h>
#include <zephyr/kernel.h>
#include <zephyr/shell/shell.h>
#include <lvgl.h>

#include "sequencer.h"
#include "ui.h"
#include "audio_out.h"

static sequencer_t seq;

/* --- LVGL UI callbacks --------------------------------------------------
 * The UI never mutates `seq` itself (see ui.h) -- it calls these, exactly
 * the way the shell commands below do, so the touchscreen and the shell
 * are two front ends onto one model rather than two copies of the logic.
 */

static void ui_cb_toggle_step(int track, int step)
{
	sequencer_toggle(&seq, track, step);
}

static void ui_cb_set_bpm(int bpm)
{
	sequencer_set_bpm(&seq, (uint16_t)bpm);
	ui_sync_from_sequencer(&seq);
}

static void ui_cb_load_demo(void)
{
	sequencer_load_demo_pattern(&seq);
	ui_sync_from_sequencer(&seq);
	ui_set_status("Demo pattern loaded");
}

static void ui_cb_clear(void)
{
	memset(seq.steps, 0, sizeof(seq.steps));
	ui_sync_from_sequencer(&seq);
	ui_set_status("Pattern cleared");
}

static void ui_cb_render(uint32_t bars)
{
	ui_set_status("Streaming...");
	int ret = audio_out_render_and_stream(&seq, bars);

	ui_set_status(ret == 0 ? "Done" : "uart1 not ready");
}

/* --- shell commands (all on uart0, unaffected by the above) ----------- */

static int cmd_seq_bpm(const struct shell *sh, size_t argc, char **argv)
{
	if (argc != 2) {
		shell_error(sh, "usage: seq bpm <40-300>");
		return -EINVAL;
	}
	sequencer_set_bpm(&seq, (uint16_t)atoi(argv[1]));
	ui_sync_from_sequencer(&seq);
	shell_print(sh, "bpm set to %d", seq.bpm);
	return 0;
}

static int cmd_seq_toggle(const struct shell *sh, size_t argc, char **argv)
{
	if (argc != 3) {
		shell_error(sh, "usage: seq toggle <track 0-3> <step 0-15>");
		return -EINVAL;
	}
	int track = atoi(argv[1]);
	int step = atoi(argv[2]);

	sequencer_toggle(&seq, track, step);
	ui_sync_from_sequencer(&seq);
	shell_print(sh, "track %d step %d -> %s", track, step,
		    seq.steps[track][step] ? "on" : "off");
	return 0;
}

static int cmd_seq_pattern_demo(const struct shell *sh, size_t argc, char **argv)
{
	ARG_UNUSED(argc);
	ARG_UNUSED(argv);
	sequencer_load_demo_pattern(&seq);
	ui_sync_from_sequencer(&seq);
	shell_print(sh, "loaded demo pattern (kick/snare/hihat/tone), bpm=%d", seq.bpm);
	return 0;
}

static int cmd_seq_clear(const struct shell *sh, size_t argc, char **argv)
{
	ARG_UNUSED(argc);
	ARG_UNUSED(argv);
	memset(seq.steps, 0, sizeof(seq.steps));
	ui_sync_from_sequencer(&seq);
	shell_print(sh, "pattern cleared");
	return 0;
}

static int cmd_seq_render(const struct shell *sh, size_t argc, char **argv)
{
	uint32_t bars = 1;

	if (argc == 2) {
		bars = (uint32_t)atoi(argv[1]);
	}
	if (bars == 0 || bars > 8) {
		shell_error(sh, "usage: seq render [bars 1-8]");
		return -EINVAL;
	}
	shell_print(sh, "streaming %d bar(s) at %d bpm out uart1...", bars, seq.bpm);
	int ret = audio_out_render_and_stream(&seq, bars);

	if (ret == 0) {
		shell_print(sh, "done.");
	}
	return ret;
}

SHELL_STATIC_SUBCMD_SET_CREATE(sub_seq,
	SHELL_CMD_ARG(bpm, NULL, "set tempo: seq bpm <40-300>", cmd_seq_bpm, 2, 0),
	SHELL_CMD_ARG(toggle, NULL, "toggle a step: seq toggle <track> <step>",
		      cmd_seq_toggle, 3, 0),
	SHELL_CMD(pattern_demo, NULL, "load the built-in demo pattern", cmd_seq_pattern_demo),
	SHELL_CMD(clear, NULL, "clear all steps", cmd_seq_clear),
	SHELL_CMD_ARG(render, NULL, "stream N bars of PCM out uart1: seq render [bars]",
		      cmd_seq_render, 1, 1),
	SHELL_SUBCMD_SET_END
);
SHELL_CMD_REGISTER(seq, &sub_seq, "Pocket Operator style step sequencer", NULL);

int main(void)
{
	sequencer_init(&seq);
	sequencer_load_demo_pattern(&seq);

	printk("\nbeatbox ready. Demo pattern loaded, bpm=%d.\n", seq.bpm);
	printk("Audio streams out uart1 as raw PCM (see README for how to capture it).\n");
	printk("Try: seq render 2 / seq toggle 3 2 / seq bpm 140, or use the touchscreen.\n\n");

	if (!audio_out_is_ready()) {
		printk("WARNING: audio output device not ready at boot -- check the "
		       "devicetree overlay before expecting audio out.\n");
	}

	ui_callbacks_t ui_cbs = {
		.toggle_step = ui_cb_toggle_step,
		.set_bpm = ui_cb_set_bpm,
		.load_demo = ui_cb_load_demo,
		.clear = ui_cb_clear,
		.render = ui_cb_render,
	};
	ui_init(&ui_cbs, &seq);

	/* auto-stream once at boot so you get audio even without touching
	 * the screen or the shell.
	 */
	audio_out_render_and_stream(&seq, 2);

	/* LVGL needs periodic pumping to redraw and to poll the SDL mouse
	 * (acting as a touch input) on native_sim. The shell and audio
	 * streaming both run fine from their own threads regardless of
	 * this loop -- this is purely the display's heartbeat.
	 */
	while (1) {
		lv_timer_handler();
		k_msleep(10);
	}

	return 0;
}
```

## src/audio_out.c
```c
/*
 * Copyright (c) 2026 Muhammad Waleed Badar
 *
 * SPDX-License-Identifier: Apache-2.0
 */

/*
 * The ONE native_sim-specific file in this app: since native_sim has
 * no DAC/PWM/I2S peripheral, rendered PCM is streamed out uart1 as
 * raw bytes instead -- on native_sim that shows up as a pseudo-tty
 * (see wav_capture.py), on real hardware you'd point uart1's
 * devicetree node at an actual UART pin pair going to a codec/DAC
 * module, or replace this file's insides with a PWM/I2S/DAC driver
 * call. Either way, sequencer.c / synth.c never touch a peripheral
 * directly, so they don't change.
 */

#include <errno.h>
#include <zephyr/kernel.h>
#include <zephyr/device.h>
#include <zephyr/drivers/uart.h>

#include "audio_out.h"
#include "synth.h" /* for SAMPLE_RATE */

#define UART1_NODE DT_NODELABEL(uart1)

static const struct device *const uart1_dev = DEVICE_DT_GET(UART1_NODE);

/* Tiny 8-byte header so the host script can pull the sample rate out
 * of the stream instead of hardcoding it: 4-byte magic + little-endian
 * uint32 sample rate, then raw int16 LE PCM samples follow with no
 * further framing.
 */
static void uart1_send_header(uint32_t rate)
{
	static const char magic[4] = { 'P', 'S', 'I', 'M' };

	for (int i = 0; i < 4; i++) {
		uart_poll_out(uart1_dev, (uint8_t)magic[i]);
	}
	for (int i = 0; i < 4; i++) {
		uart_poll_out(uart1_dev, (uint8_t)((rate >> (8 * i)) & 0xFF));
	}
}

static void emit_uart1_chunk(const int16_t *frames, size_t count)
{
	for (size_t i = 0; i < count; i++) {
		uint16_t s = (uint16_t)frames[i];

		uart_poll_out(uart1_dev, (uint8_t)(s & 0xFF));
		uart_poll_out(uart1_dev, (uint8_t)((s >> 8) & 0xFF));
	}
}

bool audio_out_is_ready(void)
{
	return device_is_ready(uart1_dev);
}

int audio_out_render_and_stream(sequencer_t *seq, uint32_t bars)
{
	if (!audio_out_is_ready()) {
		printk("uart1 not ready -- check the devicetree overlay "
		       "(boards/native_sim.overlay) and that its Kconfig "
		       "driver is enabled\n");
		return -ENODEV;
	}
	uart1_send_header(SAMPLE_RATE);
	sequencer_render(seq, bars, emit_uart1_chunk);
	return 0;
}
```

## src/audio_out.h
```c
/*
 * Copyright (c) 2026 Muhammad Waleed Badar
 *
 * SPDX-License-Identifier: Apache-2.0
 */


#ifndef AUDIO_OUT_H_
#define AUDIO_OUT_H_

#include <stdint.h>
#include <stdbool.h>
#include "sequencer.h"

/* Everything native_sim-specific about getting audio out of this app
 * lives behind these two calls. On real hardware, this .h stays the
 * same and only audio_out.c's insides change (point uart1's
 * devicetree node at a real UART pin pair, or swap the body for a
 * PWM/I2S/DAC driver call) -- main.c, sequencer.c and synth.c don't
 * need to know which one is happening.
 */

/* True once the underlying device (uart1 on native_sim) is ready.
 * Check this at boot to warn early instead of only failing at the
 * first render.
 */
bool audio_out_is_ready(void);

/* Renders `bars` bars of `seq` and streams the PCM out. Returns 0 on
 * success, -ENODEV if the output device isn't ready.
 */
int audio_out_render_and_stream(sequencer_t *seq, uint32_t bars);

#endif /* AUDIO_OUT_H_ */
```

## src/audio_pcm.c
```c
/*
 * Copyright (c) 2026 Muhammad Waleed Badar
 *
 * SPDX-License-Identifier: Apache-2.0
 */

/*
 * The ONE native_sim-specific file in this app: since native_sim has
 * no DAC/PWM/I2S peripheral, rendered PCM is streamed out uart1 as
 * raw bytes instead -- on native_sim that shows up as a pseudo-tty
 * (see wav_capture.py), on real hardware you'd point uart1's
 * devicetree node at an actual UART pin pair going to a codec/DAC
 * module, or replace this file's insides with a PWM/I2S/DAC driver
 * call. Either way, sequencer.c / synth.c never touch a peripheral
 * directly, so they don't change.
 */

#include <errno.h>
#include <zephyr/kernel.h>
#include <zephyr/device.h>
#include <zephyr/drivers/uart.h>

#include "audio_out.h"
#include "synth.h" /* for SAMPLE_RATE */

bool audio_out_is_ready(void)
{
	return 0;
}

int audio_out_render_and_stream(sequencer_t *seq, uint32_t bars)
{
	if (!audio_out_is_ready()) {
		printk("PCM device not ready\n");
		return -ENODEV;
	}

	printk("audio_out_render_and_stream not implemented\n");
	return -ENOTSUP;
}
```

## src/sequencer.c
```c
/*
 * Copyright (c) 2026 Muhammad Waleed Badar
 *
 * SPDX-License-Identifier: Apache-2.0
 */

#include <string.h>
#include "sequencer.h"

/* Chunk size for rendering each step. Kept small and fixed so RAM
 * usage doesn't depend on BPM or how many bars are requested --
 * this is the piece that would stay identical when this code moves
 * off native_sim onto a real MCU driving a DAC/PWM/I2S peripheral.
 */
#define STEP_BUF_MAX 512

static const sound_id_t track_sound[NUM_TRACKS] = {
	SOUND_KICK,
	SOUND_SNARE,
	SOUND_HIHAT,
	SOUND_TONE,
};

void sequencer_init(sequencer_t *seq)
{
	memset(seq->steps, 0, sizeof(seq->steps));
	seq->bpm = 120;
	for (int t = 0; t < NUM_TRACKS; t++) {
		synth_voice_init(&seq->voices[t], track_sound[t]);
	}
}

void sequencer_toggle(sequencer_t *seq, int track, int step)
{
	if (track < 0 || track >= NUM_TRACKS || step < 0 || step >= NUM_STEPS) {
		return;
	}
	seq->steps[track][step] = !seq->steps[track][step];
}

void sequencer_set_bpm(sequencer_t *seq, uint16_t bpm)
{
	if (bpm < 40) {
		bpm = 40;
	} else if (bpm > 300) {
		bpm = 300;
	}
	seq->bpm = bpm;
}

void sequencer_load_demo_pattern(sequencer_t *seq)
{
	memset(seq->steps, 0, sizeof(seq->steps));

	/* kick on the four-on-the-floor beats */
	seq->steps[0][0] = true;
	seq->steps[0][4] = true;
	seq->steps[0][8] = true;
	seq->steps[0][12] = true;

	/* snare on the backbeat */
	seq->steps[1][4] = true;
	seq->steps[1][12] = true;

	/* hihat every other step */
	for (int s = 0; s < NUM_STEPS; s += 2) {
		seq->steps[2][s] = true;
	}

	/* a little melodic tone accent */
	seq->steps[3][0] = true;
	seq->steps[3][7] = true;
	seq->steps[3][10] = true;

	seq->bpm = 120;
}

void sequencer_render(sequencer_t *seq, uint32_t bars, sequencer_emit_cb_t emit)
{
	uint32_t step_samples = (SAMPLE_RATE * 60u) / ((uint32_t)seq->bpm * 4u);
	int32_t mix[STEP_BUF_MAX];
	int16_t buf[STEP_BUF_MAX];

	for (uint32_t bar = 0; bar < bars; bar++) {
		for (int step = 0; step < NUM_STEPS; step++) {
			for (int t = 0; t < NUM_TRACKS; t++) {
				if (seq->steps[t][step]) {
					synth_voice_trigger(&seq->voices[t]);
				}
			}

			uint32_t remaining = step_samples;

			while (remaining > 0) {
				uint32_t chunk = remaining > STEP_BUF_MAX ? STEP_BUF_MAX : remaining;

				memset(mix, 0, chunk * sizeof(int32_t));
				for (int t = 0; t < NUM_TRACKS; t++) {
					synth_voice_render(&seq->voices[t], mix, chunk);
				}
				/* soft clip in 32-bit, then narrow to int16_t --
				 * cheaper than a real limiter, good enough for
				 * four voices max
				 */
				for (uint32_t i = 0; i < chunk; i++) {
					int32_t s = mix[i];

					if (s > 16000) {
						s = 16000;
					} else if (s < -16000) {
						s = -16000;
					}
					buf[i] = (int16_t)s;
				}

				if (emit) {
					emit(buf, chunk);
				}
				remaining -= chunk;
			}
		}
	}
}
```

## src/sequencer.h
```c
/*
 * Copyright (c) 2026 Muhammad Waleed Badar
 *
 * SPDX-License-Identifier: Apache-2.0
 */

#ifndef SEQUENCER_H_
#define SEQUENCER_H_

#include <stdint.h>
#include <stdbool.h>
#include <stddef.h>
#include "synth.h"

#define NUM_TRACKS 4
#define NUM_STEPS  16

/* Track -> sound mapping is fixed, like a Pocket Operator: each
 * track is one voice, not an arbitrary instrument slot.
 */
typedef struct {
	bool steps[NUM_TRACKS][NUM_STEPS];
	synth_voice_t voices[NUM_TRACKS];
	uint16_t bpm;
} sequencer_t;

void sequencer_init(sequencer_t *seq);
void sequencer_toggle(sequencer_t *seq, int track, int step);
void sequencer_set_bpm(sequencer_t *seq, uint16_t bpm);
void sequencer_load_demo_pattern(sequencer_t *seq);

/* Renders `bars` bars (16 steps each) of audio and calls emit() with
 * each step's worth of samples as they're produced, instead of
 * building one giant buffer -- this keeps RAM use flat regardless of
 * how many bars are requested, which matters once this runs on an
 * actual microcontroller instead of native_sim.
 */
typedef void (*sequencer_emit_cb_t)(const int16_t *frames, size_t count);

void sequencer_render(sequencer_t *seq, uint32_t bars, sequencer_emit_cb_t emit);

#endif /* SEQUENCER_H_ */
```

## src/synth.c
```c
/*
 * Copyright (c) 2026 Muhammad Waleed Badar
 *
 * SPDX-License-Identifier: Apache-2.0
 */

#include "synth.h"

/* --- helpers -------------------------------------------------------- */

static inline uint32_t phase_inc(uint32_t freq_hz)
{
	/* Q32 fixed point phase increment for a given frequency */
	return (uint32_t)(((uint64_t)freq_hz << 32) / SAMPLE_RATE);
}

static inline int16_t square_from_phase(uint32_t phase, int16_t amp)
{
	return (phase & 0x80000000u) ? -amp : amp;
}

/* 16-bit Galois LFSR, taps chosen for maximal length. Cheap, no
 * multiply/divide -- fine for a Cortex-M0 with no hardware RNG.
 */
static inline uint32_t lfsr_step(uint32_t *state)
{
	uint32_t lsb = *state & 1u;

	*state >>= 1;
	if (lsb) {
		*state ^= 0xB400u;
	}
	return *state;
}

static inline int16_t noise_sample(uint32_t *lfsr, int16_t amp)
{
	return (lfsr_step(lfsr) & 1u) ? amp : (int16_t)(-amp);
}

/* --- public API ------------------------------------------------------ */

void synth_voice_init(synth_voice_t *voice, sound_id_t sound)
{
	voice->sound = sound;
	voice->active = false;
	voice->age_samples = 0;
	voice->phase = 0;
	voice->lfsr = 0xACE1u; /* any nonzero seed */
}

void synth_voice_trigger(synth_voice_t *voice)
{
	voice->active = true;
	voice->age_samples = 0;
	voice->phase = 0;
	/* Deliberately don't reset the LFSR -- keeps successive hits
	 * from sounding identical, which a reset seed would cause.
	 */
}

static void render_kick(synth_voice_t *v, int32_t *out, size_t frames)
{
	const uint32_t decay = (SAMPLE_RATE * 220u) / 1000u;
	const uint32_t f_start = 180, f_end = 45;
	const int16_t max_amp = 12000;

	for (size_t i = 0; i < frames && v->active; i++) {
		if (v->age_samples >= decay) {
			v->active = false;
			break;
		}
		uint32_t freq = f_start - ((f_start - f_end) * v->age_samples) / decay;
		v->phase += phase_inc(freq);
		int32_t amp = max_amp - (int32_t)((max_amp * (uint64_t)v->age_samples) / decay);

		out[i] += square_from_phase(v->phase, (int16_t)amp);
		v->age_samples++;
	}
}

static void render_snare(synth_voice_t *v, int32_t *out, size_t frames)
{
	const uint32_t decay = (SAMPLE_RATE * 150u) / 1000u;
	const uint32_t tone_decay = (SAMPLE_RATE * 90u) / 1000u;
	const int16_t noise_amp = 9000;
	const int16_t tone_amp = 4000;

	for (size_t i = 0; i < frames && v->active; i++) {
		if (v->age_samples >= decay) {
			v->active = false;
			break;
		}
		int32_t namp = noise_amp - (int32_t)((noise_amp * (uint64_t)v->age_samples) / decay);
		int16_t sample = noise_sample(&v->lfsr, (int16_t)namp);

		if (v->age_samples < tone_decay) {
			v->phase += phase_inc(190);
			int32_t tamp = tone_amp -
				       (int32_t)((tone_amp * (uint64_t)v->age_samples) / tone_decay);
			sample += square_from_phase(v->phase, (int16_t)tamp);
		}
		out[i] += sample;
		v->age_samples++;
	}
}

static void render_hihat(synth_voice_t *v, int32_t *out, size_t frames)
{
	const uint32_t decay = (SAMPLE_RATE * 45u) / 1000u;
	const int16_t max_amp = 7000;

	for (size_t i = 0; i < frames && v->active; i++) {
		if (v->age_samples >= decay) {
			v->active = false;
			break;
		}
		int32_t amp = max_amp - (int32_t)((max_amp * (uint64_t)v->age_samples) / decay);

		/* step the LFSR twice per sample for a "brighter"/denser
		 * feel than the snare's noise, without needing a real
		 * high-pass filter
		 */
		lfsr_step(&v->lfsr);
		out[i] += noise_sample(&v->lfsr, (int16_t)amp);
		v->age_samples++;
	}
}

static void render_tone(synth_voice_t *v, int32_t *out, size_t frames)
{
	const uint32_t decay = (SAMPLE_RATE * 180u) / 1000u;
	const int16_t max_amp = 10000;

	for (size_t i = 0; i < frames && v->active; i++) {
		if (v->age_samples >= decay) {
			v->active = false;
			break;
		}
		v->phase += phase_inc(440);
		int32_t amp = max_amp - (int32_t)((max_amp * (uint64_t)v->age_samples) / decay);

		out[i] += square_from_phase(v->phase, (int16_t)amp);
		v->age_samples++;
	}
}

void synth_voice_render(synth_voice_t *voice, int32_t *out, size_t frames)
{
	if (!voice->active) {
		return;
	}

	switch (voice->sound) {
	case SOUND_KICK:
		render_kick(voice, out, frames);
		break;
	case SOUND_SNARE:
		render_snare(voice, out, frames);
		break;
	case SOUND_HIHAT:
		render_hihat(voice, out, frames);
		break;
	case SOUND_TONE:
		render_tone(voice, out, frames);
		break;
	default:
		break;
	}
}
```

## src/synth.h
```c
/*
 * Copyright (c) 2026 Muhammad Waleed Badar
 *
 * SPDX-License-Identifier: Apache-2.0
 */

#ifndef SYNTH_H_
#define SYNTH_H_

#include <stdint.h>
#include <stdbool.h>
#include <stddef.h>

#define SAMPLE_RATE 22050

typedef enum {
	SOUND_KICK = 0,
	SOUND_SNARE,
	SOUND_HIHAT,
	SOUND_TONE,
	SOUND_COUNT
} sound_id_t;

/* One synth voice: one per track. Very deliberately not a "real"
 * synth (no filters, no proper oscillator table) -- this is the
 * minimum needed to get four distinguishable percussive/tonal
 * sounds out of pure integer math, so it stays portable to a
 * Cortex-M with no FPU.
 */
typedef struct {
	sound_id_t sound;
	bool active;
	uint32_t age_samples;   /* samples since trigger */
	uint32_t phase;         /* Q32 phase accumulator for tonal voices */
	uint32_t lfsr;          /* noise state for noisy voices */
} synth_voice_t;

void synth_voice_init(synth_voice_t *voice, sound_id_t sound);
void synth_voice_trigger(synth_voice_t *voice);

/* Render `frames` samples for this voice and ADD them into out[]
 * (out is not cleared here -- caller is responsible for mixing).
 * out[] is int32_t so multiple voices can be summed without
 * wrapping before the caller clips down to int16_t.
 * Marks voice->active = false once its envelope has finished.
 */
void synth_voice_render(synth_voice_t *voice, int32_t *out, size_t frames);

#endif /* SYNTH_H_ */
```

## src/ui.c
```c
/*
 * Copyright (c) 2026 Muhammad Waleed Badar
 *
 * SPDX-License-Identifier: Apache-2.0
 */

#include <zephyr/kernel.h>
#include <zephyr/device.h>
#include <zephyr/drivers/display.h>
#include <lvgl.h>
#include <stdio.h>
#include <stdbool.h>

#include "ui.h"
#include "sequencer.h"

static ui_callbacks_t cbs;
static lv_obj_t *step_btn[NUM_TRACKS][NUM_STEPS];
static lv_obj_t *bpm_label;
static lv_obj_t *status_label;
static int current_bpm;

static const char *track_names[NUM_TRACKS] = { "Kick", "Snr", "Hat", "Tone" };

/* Relative weights for lv_obj_set_flex_grow() on the top-level rows.
 * The step grid (4 track rows) gets more of the screen than the bpm
 * or transport rows -- tune these, not pixel heights, to change the
 * proportions.
 */
#define GROW_BPM_ROW       1
#define GROW_TRACK_ROW     2
#define GROW_TRANSPORT_ROW 1

/* Explicit styling for each step button's off/on look. Plain lv_obj
 * default styling would already show a box, but this makes "on"
 * unmistakable rather than relying on the theme's default checked
 * look (which can be subtle).
 */
static lv_style_t style_step_off;
static lv_style_t style_step_on;
static bool step_styles_ready;

static void ensure_step_styles(void)
{
	if (step_styles_ready) {
		return;
	}

	lv_style_init(&style_step_off);
	lv_style_set_radius(&style_step_off, 3);
	lv_style_set_border_width(&style_step_off, 2);
	lv_style_set_border_color(&style_step_off, lv_palette_main(LV_PALETTE_GREY));
	lv_style_set_bg_color(&style_step_off, lv_color_white());
	lv_style_set_bg_opa(&style_step_off, LV_OPA_COVER);

	lv_style_init(&style_step_on);
	lv_style_set_bg_color(&style_step_on, lv_palette_main(LV_PALETTE_BLUE));
	lv_style_set_bg_opa(&style_step_on, LV_OPA_COVER);
	lv_style_set_border_color(&style_step_on, lv_palette_darken(LV_PALETTE_BLUE, 2));

	step_styles_ready = true;
}

/* Track/step are packed into one user_data pointer so every step
 * button can share this one callback instead of needing 64 separate
 * closures.
 */
static void step_btn_event_cb(lv_event_t *e)
{
	int packed = (int)(intptr_t)lv_event_get_user_data(e);
	int track = packed / 100;
	int step = packed % 100;

	/* the button already flipped its own LV_STATE_CHECKED visually
	 * (LV_OBJ_FLAG_CHECKABLE handles that) -- just tell the model
	 */
	if (cbs.toggle_step) {
		cbs.toggle_step(track, step);
	}
}

static void bpm_delta_cb(lv_event_t *e)
{
	int delta = (int)(intptr_t)lv_event_get_user_data(e);

	if (cbs.set_bpm) {
		cbs.set_bpm(current_bpm + delta);
	}
}

static void demo_cb(lv_event_t *e)
{
	ARG_UNUSED(e);
	if (cbs.load_demo) {
		cbs.load_demo();
	}
}

static void clear_cb(lv_event_t *e)
{
	ARG_UNUSED(e);
	if (cbs.clear) {
		cbs.clear();
	}
}

static void render_cb(lv_event_t *e)
{
	uint32_t bars = (uint32_t)(intptr_t)lv_event_get_user_data(e);

	if (cbs.render) {
		cbs.render(bars);
	}
}

static lv_obj_t *make_text_button(lv_obj_t *parent, const char *text,
				   lv_event_cb_t cb, void *user_data)
{
	lv_obj_t *btn = lv_btn_create(parent);

	lv_obj_add_event_cb(btn, cb, LV_EVENT_CLICKED, user_data);
	lv_obj_t *lbl = lv_label_create(btn);

	lv_label_set_text(lbl, text);
	lv_obj_center(lbl);
	return btn;
}

/* A full-width row whose height is a share of the screen (via flex
 * grow on the parent column), rather than a fixed pixel height.
 */
static lv_obj_t *make_row(lv_obj_t *parent, int flex_grow)
{
	lv_obj_t *row = lv_obj_create(parent);

	lv_obj_set_width(row, LV_PCT(100));
	lv_obj_set_height(row, LV_SIZE_CONTENT); /* flex_grow overrides this */
	lv_obj_set_flex_grow(row, flex_grow);
	lv_obj_set_flex_flow(row, LV_FLEX_FLOW_ROW);
	lv_obj_set_flex_align(row, LV_FLEX_ALIGN_SPACE_EVENLY,
			      LV_FLEX_ALIGN_CENTER, LV_FLEX_ALIGN_CENTER);
	return row;
}

void ui_init(const ui_callbacks_t *callbacks, const sequencer_t *seq)
{
	cbs = *callbacks;
	current_bpm = seq->bpm;
	ensure_step_styles();

	const struct device *display_dev = DEVICE_DT_GET(DT_CHOSEN(zephyr_display));

	if (!device_is_ready(display_dev)) {
		printk("UI: display device not ready -- check the devicetree "
		       "chosen zephyr,display node\n");
		return;
	}

	lv_obj_t *scr = lv_scr_act();

	/* scr is already exactly the display's resolution, so a column
	 * flex layout on it with flex_grow rows below is what makes the
	 * whole UI scale with screen size instead of any fixed pixel math.
	 */
	lv_obj_set_flex_flow(scr, LV_FLEX_FLOW_COLUMN);
	lv_obj_set_style_pad_row(scr, 2, 0);
	lv_obj_set_style_pad_all(scr, 4, 0);

	/* --- bpm row --- */
	lv_obj_t *bpm_row = make_row(scr, GROW_BPM_ROW);

	make_text_button(bpm_row, "-5", bpm_delta_cb, (void *)(intptr_t)(-5));
	bpm_label = lv_label_create(bpm_row);
	lv_label_set_text_fmt(bpm_label, "%d BPM", current_bpm);
	make_text_button(bpm_row, "+5", bpm_delta_cb, (void *)(intptr_t)(5));

	/* --- 4x16 step grid, one row of plain checkable buttons per track --- */
	for (int t = 0; t < NUM_TRACKS; t++) {
		lv_obj_t *row = make_row(scr, GROW_TRACK_ROW);

		/* packed edge-to-edge, not spread out like the button rows */
		lv_obj_set_flex_align(row, LV_FLEX_ALIGN_START,
				      LV_FLEX_ALIGN_CENTER, LV_FLEX_ALIGN_CENTER);
		lv_obj_set_style_pad_column(row, 3, 0);

		lv_obj_t *name_lbl = lv_label_create(row);

		/* content-sized, not a fixed percentage: the label's width
		 * adjusts to whatever text is passed to lv_label_set_text()
		 * here, so track_names[] entries can change length (or this
		 * can be swapped for a runtime-editable track name later)
		 * without leaving dead space or clipping the text.
		 */
		lv_label_set_text(name_lbl, track_names[t]);
		lv_obj_set_width(name_lbl, LV_SIZE_CONTENT);
		lv_obj_set_height(name_lbl, LV_PCT(100));

		for (int s = 0; s < NUM_STEPS; s++) {
			lv_obj_t *btn = lv_btn_create(row);

			lv_obj_set_height(btn, LV_PCT(100));
			lv_obj_set_flex_grow(btn, 1); /* 16 buttons split what's left */
			lv_obj_add_flag(btn, LV_OBJ_FLAG_CHECKABLE);
			lv_obj_add_style(btn, &style_step_off, LV_STATE_DEFAULT);
			lv_obj_add_style(btn, &style_step_on, LV_STATE_CHECKED);

			int packed = t * 100 + s;

			lv_obj_add_event_cb(btn, step_btn_event_cb, LV_EVENT_CLICKED,
					    (void *)(intptr_t)packed);
			step_btn[t][s] = btn;
		}
	}

	/* --- transport row --- */
	lv_obj_t *transport_row = make_row(scr, GROW_TRANSPORT_ROW);

	make_text_button(transport_row, "Demo", demo_cb, NULL);
	make_text_button(transport_row, "Clear", clear_cb, NULL);
	make_text_button(transport_row, "Render x1", render_cb, (void *)(intptr_t)1);
	make_text_button(transport_row, "Render x2", render_cb, (void *)(intptr_t)2);

	/* --- status line -- content-height, not part of the grow split --- */
	status_label = lv_label_create(scr);
	lv_label_set_text(status_label, "Ready");

	display_blanking_off(display_dev);
	ui_sync_from_sequencer(seq);
}

void ui_sync_from_sequencer(const sequencer_t *seq)
{
	current_bpm = seq->bpm;
	if (bpm_label) {
		lv_label_set_text_fmt(bpm_label, "%d BPM", current_bpm);
	}

	for (int t = 0; t < NUM_TRACKS; t++) {
		for (int s = 0; s < NUM_STEPS; s++) {
			if (!step_btn[t][s]) {
				continue;
			}
			if (seq->steps[t][s]) {
				lv_obj_add_state(step_btn[t][s], LV_STATE_CHECKED);
			} else {
				lv_obj_clear_state(step_btn[t][s], LV_STATE_CHECKED);
			}
		}
	}
}

void ui_set_status(const char *text)
{
	if (status_label) {
		lv_label_set_text(status_label, text);
	}
}
```

## src/ui.h
```c
/*
 * Copyright (c) 2026 Muhammad Waleed Badar
 *
 * SPDX-License-Identifier: Apache-2.0
 */

#ifndef UI_H_
#define UI_H_

#include <stdint.h>
#include "sequencer.h"

/* The UI never touches the sequencer directly -- it only calls these,
 * the same way the shell commands in main.c do. Keeps the touchscreen
 * and the shell as two equally-valid front ends to one model, instead
 * of the UI reaching into sequencer state on its own.
 */
typedef struct {
	void (*toggle_step)(int track, int step);
	void (*set_bpm)(int bpm);
	void (*load_demo)(void);
	void (*clear)(void);
	void (*render)(uint32_t bars);
} ui_callbacks_t;

/* Builds the screen and turns the display on. Call once at boot,
 * after the sequencer itself is initialized.
 */
void ui_init(const ui_callbacks_t *cbs, const sequencer_t *seq);

/* Re-reads seq's bpm + step grid and redraws the on-screen state to
 * match. Call this after ANY mutation to the sequencer that didn't
 * come through a ui_callbacks_t call -- i.e. after every shell
 * command -- so the touchscreen and shell never show different
 * patterns.
 */
void ui_sync_from_sequencer(const sequencer_t *seq);

/* One-line status text at the bottom of the screen, e.g. "Streaming..." */
void ui_set_status(const char *text);

#endif /* UI_H_ */
```
